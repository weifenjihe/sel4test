/*
 * Copyright 2025, seL4 Project
 *
 * SPDX-License-Identifier: GPL-2.0-only
 */

/ {
    memory@b0000000 {
        device_type = "memory";
        // Memory from 0xb0000000, size 768MB for Phytium Pi
        reg = <0x00 0xb0000000 0x00 0x30000000>;
    };
    
    /* Reserved memory for 32-bit mode */
    // reserved-memory {
    //     #address-cells = <2>;
    //     #size-cells = <2>;
    //     ranges;
        
    //     /* Shared memory region - must not be used by seL4 in 32-bit mode */
    //     hvisor_shm_32: shm@de000000 {
    //         compatible = "shared-dma-pool";
    //         no-map;
    //         reg = <0x00 0xde000000 0x00 0x420000>;
    //     };
    // };
};
